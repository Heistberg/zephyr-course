## CMakeLists.txt
```
cmake_minimum_required(VERSION 3.20.0)

list(APPEND BOARD_ROOT ${CMAKE_CURRENT_SOURCE_DIR}/..)
find_package(Zephyr REQUIRED)
project(my_zephyr_app)

target_sources(app PRIVATE src/main.cpp)
add_subdirectory(drivers/our_driver)
```

## Kconfig
```
config APP_HEARTBEAT_PERIOD_MS
    int "Heartbeat period (ms)"
    default 500
    range 100 2000
    
menuconfig LED_SUBSYSTEM
    bool "LED Subsystem"

if LED_SUBSYSTEM
    choice BLINK_SLEEP_CHOICE
        prompt "LED blink sleep time"
        default BLINK_SLEEP_1000MS

        config BLINK_SLEEP_250MS
            bool "Fast (250ms)"

        config BLINK_SLEEP_1000MS
            bool "Medium (1s)"

        config BLINK_SLEEP_2000MS
            bool "Slow (2s)"
    endchoice

    config BLINK_SLEEP_TIME_MS
        int
        default 250 if BLINK_SLEEP_250MS
        default 1000 if BLINK_SLEEP_1000MS
        default 2000 if BLINK_SLEEP_2000MS
            
    menuconfig LED_ADVANCED
        bool "Advanced LED settings"
        default n

    if LED_ADVANCED
        config LED_BRIGHTNESS
            int "LED brightness (0-100)"
            default 100
            range 0 100
            
        config LED_FADE_MS
            int "LED fade duration (ms)"
            default 500
            range 0 5000

        menu "Expert settings"
            visible if LED_ADVANCED
            config LED_DEBUG_ENABLED
                bool "Enable LED debugging"
                default n

            config CUSTOM_BLINK_PATTERN
                bool "Custom blink pattern"
                default n
        endmenu
    endif
endif

source "Kconfig.zephyr"
rsource "drivers/our_driver/Kconfig"
```

## prj.conf
```kconfig
CONFIG_GPIO=y
CONFIG_LOG=y
CONFIG_OUR_DRIVER=y
CONFIG_LOG_BACKEND_UART=y
CONFIG_SHELL=y
CONFIG_SHELL_BACKEND_SERIAL=y
```

## app.overlay
```dts
/ {
    aliases {
        app-led = &blue_led;
	};
};
```

## src/main.cpp
```c
#include <zephyr/drivers/sensor.h>
#include <zephyr/kernel.h>
#include <zephyr/logging/log.h>
#include <our_driver.h>

/* The devicetree node identifier for the "app-led" alias. */

LOG_MODULE_REGISTER(main, LOG_LEVEL_INF);

const struct device* driver = DEVICE_DT_GET(DT_NODELABEL(our_driver0));

int main(void)
{
    struct sensor_value val;
    int iter = 0;
    bool led_state = true;
    
    while (1) {
        auto ret2 = sensor_sample_fetch(driver);
        k_msleep(CONFIG_APP_HEARTBEAT_PERIOD_MS);
        
        auto ret1 = sensor_channel_get(driver, SENSOR_CHAN_AMBIENT_TEMP, &val);
        k_msleep(CONFIG_APP_HEARTBEAT_PERIOD_MS);

        our_driver_set_custom_value(driver, iter++);
    }
    return 0;
}
```
