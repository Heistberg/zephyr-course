## app/boards/our_board/board.yml
```yaml
# Copyright (c) 2024 Ian Morris
# SPDX-License-Identifier: Apache-2.0

board:
  name: our_board
  full_name: testTestTest
  vendor: iomico
  socs:
    - name: r7fa4m1ab3cfm
```

## boards/my_board/Kconfig.my_board
```kconfig
# Copyright (c) 2023 TOKITA Hiroshi <tokita.hiroshi@fujitsu.com>
# SPDX-License-Identifier: Apache-2.0

config BOARD_MY_BOARD
	select SOC_R7FA4M1AB3CFM
```

## boards/my_board/board.yml
```yaml
# Copyright (c) 2024 Ian Morris
# SPDX-License-Identifier: Apache-2.0

board:
  name: my_board
  full_name: my board
  vendor: iomico
  socs:
    - name: r7fa4m1ab3cfm
```

## boards/our_board/Kconfig.our_board
```kconfig
# Copyright (c) 2024 Ian Morris
# SPDX-License-Identifier: Apache-2.0

config BOARD_OUR_BOARD
	select SOC_R7FA4M1AB3CFM
```

## twister-out.1/native_sim_native/host_gnu/zephyr-course/tests/ring_buf/homework.unit.ring_buf/Kconfig/Kconfig.modules
```kconfig
menu "cmsis_6 (/home/daniel/Zephyr/deps/modules/hal/cmsis_6)"
osource "$(ZEPHYR_CMSIS_6_KCONFIG)"
config ZEPHYR_CMSIS_6_MODULE
	bool
	default y
endmenu
menu "hal_espressif (/home/daniel/Zephyr/deps/modules/hal/espressif)"
osource "/home/daniel/Zephyr/deps/modules/hal/espressif/zephyr/Kconfig"
config ZEPHYR_HAL_ESPRESSIF_MODULE
	bool
	default y
	select TAINT_BLOBS

config ZEPHYR_HAL_ESPRESSIF_MODULE_BLOBS
	bool
	default y
endmenu
config ZEPHYR_HAL_RENESAS_MODULE
	bool
	default y

config ZEPHYR_HAL_RENESAS_MODULE_BLOBS
	bool
```

## twister-out.1/native_sim_native/host_gnu/zephyr-course/tests/ring_buf/homework.unit.ring_buf/Kconfig/Kconfig.sysbuild.modules
```kconfig
config ZEPHYR_CMSIS_6_MODULE
   bool
   default y
config ZEPHYR_HAL_ESPRESSIF_MODULE
   bool
   default y
config ZEPHYR_HAL_RENESAS_MODULE
   bool
   default y
```

## twister-out.1/native_sim_native/host_gnu/zephyr-course/tests/ring_buf/homework.unit.ring_buf/Kconfig/arch/Kconfig.tmp
```kconfig
# Load Zephyr Arch Kconfig descriptions.
osource "/home/daniel/Zephyr/deps/zephyr/arch/rx/Kconfig"
osource "/home/daniel/Zephyr/deps/zephyr/arch/x86/Kconfig"
osource "/home/daniel/Zephyr/deps/zephyr/arch/xtensa/Kconfig"
osource "/home/daniel/Zephyr/deps/zephyr/arch/sparc/Kconfig"
osource "/home/daniel/Zephyr/deps/zephyr/arch/riscv/Kconfig"
osource "/home/daniel/Zephyr/deps/zephyr/arch/posix/Kconfig"
osource "/home/daniel/Zephyr/deps/zephyr/arch/openrisc/Kconfig"
osource "/home/daniel/Zephyr/deps/zephyr/arch/mips/Kconfig"
osource "/home/daniel/Zephyr/deps/zephyr/arch/arm64/Kconfig"
osource "/home/daniel/Zephyr/deps/zephyr/arch/arm/Kconfig"
osource "/home/daniel/Zephyr/deps/zephyr/arch/arc/Kconfig"
```

## twister-out/native_sim_native/host_gnu/zephyr-course/tests/ring_buf/homework.unit.ring_buf/Kconfig/boards/Kconfig
```kconfig
# Load Zephyr board Kconfig descriptions.
osource "/home/daniel/Zephyr/deps/zephyr/boards/native/native_sim/Kconfig"
```

## twister-out/native_sim_native/host_gnu/zephyr-course/tests/ring_buf/homework.unit.ring_buf/Kconfig/boards/Kconfig.defconfig
```kconfig
# Load Zephyr board defconfig descriptions.
osource "/home/daniel/Zephyr/deps/zephyr/boards/native/native_sim/Kconfig.defconfig"
```

## twister-out/native_sim_native/host_gnu/zephyr-course/tests/ring_buf/homework.unit.ring_buf/Kconfig/boards/Kconfig.native_sim
```kconfig
# Load board Kconfig descriptions.
osource "/home/daniel/Zephyr/deps/zephyr/boards/native/native_sim/Kconfig.native_sim"
```

## twister-out/native_sim_native/host_gnu/zephyr-course/tests/ring_buf/homework.unit.ring_buf/Kconfig/boards/Kconfig.sysbuild
```kconfig
# Load Sysbuild board Kconfig descriptions.
osource "/home/daniel/Zephyr/deps/zephyr/boards/native/native_sim/Kconfig.sysbuild"
```
